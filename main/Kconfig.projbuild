## main/Kconfig.projbuild
```kconfig
menu "Digital Frequency Meter"

menu "FPGA Configuration"
config FPGA_REF_CLK_FREQ
    int "FPGA Reference Clock Frequency"
    default 200000000

config FPGA_RST_PIN
    int "FPGA RST Pin"
    default 19

config FPGA_DC_PIN
    int "FPGA DC Pin"
    default 18

config SPI_SCLK_PIN
    int "SPI SCLK Pin"
    default 4

config SPI_MOSI_PIN
    int "SPI MOSI Pin"
    default 5

config SPI_MISO_PIN
    int "SPI MISO Pin"
    default 7

config SPI_CS_PIN
    int "SPI CS Pin"
    default 6
endmenu

endmenu
```

## sdkconfig.defaults
```kconfig
CONFIG_IDF_TARGET="esp32c3"

#
# Bootloader config
#
CONFIG_BOOTLOADER_SKIP_VALIDATE_IN_DEEP_SLEEP=y

#
# Serial flasher config
#
CONFIG_ESPTOOLPY_FLASHMODE_QIO=y
CONFIG_ESPTOOLPY_FLASHFREQ_80M=y
CONFIG_ESPTOOLPY_FLASHSIZE_4MB=y

#
# Partition Table
#
CONFIG_PARTITION_TABLE_CUSTOM=y
CONFIG_PARTITION_TABLE_CUSTOM_FILENAME="partitions.csv"

#
# Compiler options
#
CONFIG_COMPILER_OPTIMIZATION_PERF=y

#
# Common ESP-related
#
CONFIG_ESP_TASK_WDT=n

#
# Newlib
#
CONFIG_NEWLIB_NANO_FORMAT=y

#
# FreeRTOS
#
CONFIG_FREERTOS_HZ=1000
CONFIG_FREERTOS_SUPPORT_STATIC_ALLOCATION=y
```
